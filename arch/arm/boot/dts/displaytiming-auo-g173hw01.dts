&displaytimings {
	native-mode = <&timing0>;
	timing0: AUO-g173hw01-1920x1080 {
		clock-frequency = <127285714>;
		hactive = <1920>;
		vactive = <1080>;
		hfront-porch = <0>;
		hback-porch = <0>;
		hsync-len = <180>;
		hsync-active = <1>;
		vfront-porch = <2>;
		vback-porch = <0>;
		vsync-len = <50>;
		vsync-active = <1>;
	};
};
