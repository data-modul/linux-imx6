/*
 * Copyright 2017 Data Modul AG, Reyhaneh Yazdani <reyhane.y84@gmail.com>
 *
 * The code contained herein is licensed under the GNU General Public
 * License. You may obtain a copy of the GNU General Public License
 * Version 2 or later at the following locations:
 *
 * http://www.opensource.org/licenses/gpl-license.html
 * http://www.gnu.org/copyleft/gpl.html
 */

#include "imx6q-dmo-ppc.dts"

&ldb {
	fsl,dual-channel;

	lvds-channel@0 {
		status = "okay";
		displaytimings: display-timings {};
	};
};

#include "displaytiming-auo-g173hw01.dts"

&backlight1 {
	pwms = <&pwm1 0 200000>;
	brightness-levels = <0 1 10 20 30 40 50 60 70 75 80 90 100>;
	default-brightness-level = <7>;
	status = "okay";
};
