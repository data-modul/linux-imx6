/*
 * Copyright 2017 Data Modul AG, Reyhaneh Yazdani <reyhane.y84@gmail.com>
 *
 * The code contained herein is licensed under the GNU General Public
 * License. You may obtain a copy of the GNU General Public License
 * Version 2 or later at the following locations:
 *
 * http://www.opensource.org/licenses/gpl-license.html
 * http://www.gnu.org/copyleft/gpl.html
 */

#include "imx6q-dmo-ppc.dts"

&ldb {
	status = "okay";

	lvds-channel@1 {
		status = "okay";
		fsl,data-mapping = "spwg";
		fsl,data-width = <24>;

		displaytimings: display-timings {};
	};
};

#include "displaytiming-auo-g804sn05.dts"
