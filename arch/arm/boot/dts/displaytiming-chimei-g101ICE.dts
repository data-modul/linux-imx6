&displaytimings {
	native-mode = <&timing0>;
	timing0: Chimei-G101ICE-L01-1280x800 {
		clock-frequency = <71100000>;
		hactive = <1280>;
		vactive = <800>;
		hfront-porch = <80>;
		hback-porch = <64>;
		hsync-len = <16>;
		hsync-active = <0>;
		vfront-porch = <16>;
		vback-porch = <4>;
		vsync-len = <3>;
		vsync-active = <0>;
	};
};
