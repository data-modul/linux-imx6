/*
 * Copyright 2018 Data Modul AG, Reyhaneh Yazdani <reyhane.y84@gmail.com>
 *
 * The code contained herein is licensed under the GNU General Public
 * License. You may obtain a copy of the GNU General Public License
 * Version 2 or later at the following locations:
 *
 * http://www.opensource.org/licenses/gpl-license.html
 * http://www.gnu.org/copyleft/gpl.html
 */
/dts-v1/;

#include "imx6q.dtsi"
#include "imx6qdl-dmo-ppc.dtsi"

/ {
	model = "Data Modul AG PPC Board-Q/D";
	compatible = "dmo,imx6q-ppc", "fsl,imx6q";
};

&sata {
	status = "okay";
};

&uart2 {
	pinctrl-names = "default";
	pinctrl-0 = <&pinctrl_uart2>;
	fsl,uart-has-rtscts;
	linux,rs485-enabled-at-boot-time;
	rs485-rts-active-high;
	status = "okay";
};
